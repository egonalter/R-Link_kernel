## arch/arm/mach-s5p6450/Kconfig
```kconfig
# arch/arm/mach-s5p6450/Kconfig
#
# Copyright (c) 2009 Samsung Electronics Co., Ltd.
#		http://www.samsung.com/
#
# Licensed under GPLv2

if ARCH_S5P6450

config CPU_S5P6450
	bool
	help
	  Enable S5P6450 CPU support

config S5P_SETUP_I2C0
	bool
	default y
	help
	  Common setup code for i2c bus 0.

config S5P_SETUP_I2C1
	bool
	default y
	help
	  Common setup code for i2c bus 1.

config S5P_SETUP_I2C2
	bool
	default y
	help
	  Common setup code for i2c bus 2.
config MACH_SMDK6450
	bool "SMDK6450"
	select CPU_S5P6450
	help
	  Machine support for the Samsung SMDK6450

config MACH_TARANTO
	bool "taranto"
	depends on MACH_S5P6450_TOMTOM

config MACH_VALDEZ
	bool "taranto"
	depends on MACH_S5P6450_TOMTOM

config MACH_S5P6450_TOMTOM
	bool "s5p6450"
	select CPU_S5P6450
	select PLAT_TOMTOM
	select PLAT_MENDOZA
	select EEPROM_AT24
	select SND_SOC_BCM2070
	help
	  Machine support for the Samsung S5P6450 based TomTom Boards.

config WIFI_CONTROL_FUNC
        bool "Enable WiFi control function abstraction"
	depends on MACH_S5P6450_TOMTOM
        help
          Enables Power/Reset/Carddetect function abstraction

menu "SMDK6450 MMC/SD slot setup"
        depends on MACH_SMDK6450 || MACH_S5P6450_TOMTOM 

config SMDK6450_SD_CH0
        bool "Use channel 0"
        depends on ((MACH_SMDK6450 || MACH_S5P6450_TOMTOM) && !S5P6450_SD_CH1_8BIT)
        help
          Select CON7 (channel 0) as the MMC/SD slot, as
          at least some SMDK6450 boards come with the
          resistors fitted so that the card detects for
          channels 0 and 1 are the same.

config SMDK6450_SD_CH1
        bool "Use channel 1"
        depends on MACH_SMDK6450 || MACH_S5P6450_TOMTOM
        help
          Select CON6 (channel 1) as the MMC/SD slot, as
          at least some SMDK6450 boards come with the
          resistors fitted so that the card detects for
          channels 0 and 1 are the same.

config SMDK6450_SD_CH2
        bool "Use channel 2"
        depends on ((MACH_SMDK6450 || MACH_S5P6450_TOMTOM) && !S5P6450_SD_CH3_8BIT)
        help
          Select CON6 (channel 1) as the MMC/SD slot, as
          at least some SMDK6410 boards come with the
          resistors fitted so that the card detects for
          channels 0 and 1 are the same.

menu "Use 8-bit bus width"
	config S5P6450_SD_CH1_8BIT
	bool "Channel 1"
	depends on MACH_SMDK6450 || MACH_S5P6450_TOMTOM
	default n
	help
	 IF channel 1 uses 8-bit bus, channel 0 is disabled.

config S5P6450_SD_CH3_8BIT
	bool "Channel 3"
	depends on ((MACH_SMDK6450 || MACH_S5P6450_TOMTOM) && MMC_MSHCI && !S5P6450_SD_CH3_DDR)
	default n
	help
	 IF channel 3 uses 8-bit bus, channel 2 is disabled and can't use DDR mode.
endmenu

menu "Use DDR(Dual Data Rate)"
	config S5P6450_SD_CH3_DDR
	bool "Channel 3"
	depends on ((MACH_SMDK6450 || MACH_S5P6450_TOMTOM) && MMC_MSHCI)
	default n
	help
	 IF channel 3 is working with DDR mode, can't use 8-bit bus.
endmenu
endmenu

choice
        prompt "Default XXTI value "
        depends on (MACH_SMDK6450 || MACH_S5P6450_TOMTOM)
        default XXTI_12_MHZ
        help
         Default XXTI clk value is 12MHz

config XXTI_12_MHZ
        bool "XXTI frequency is 12000000"
        help
          Select the  clock frequency 12 MHz

config XXTI_19_MHZ
        bool "XXTI frequency is 19200000"
        help
          Select the clock frequency  19.2MHz

endchoice


#choice
menu  "Voltage Control Device"
        depends on CPU_FREQ

config S5P64XX_LTC3714
        bool "LTC3714 voltage regulator support"
        depends on (!SP6450_S5M8752 && !SP6450_S5M8751)
        help
          Voltage control device for DVFS

config S5P6450_S5M8751
        bool "S5M8751 device support"
        depends on  (!S5P64XX_LTC3714)
        help
          Multifunctional voltage control device.

config S5P6450_S5M8752
        bool "S5M8752 device support"
        depends on (!S5P6450_S5M8751 && !S5P64XX_LTC3714) 
        help
          Multifunctional voltage control device.

endmenu

endif
```

## arch/arm/mach-s5pv210/Kconfig
```kconfig
# arch/arm/mach-s5pv210/Kconfig
#
# Copyright (c) 2010 Samsung Electronics Co., Ltd.
#		http://www.samsung.com/
#
# Licensed under GPLv2

# Configuration options for the S5PV210/S5PC110

if ARCH_S5PV210

config CPU_S5PV210
	bool
	select PLAT_S5P
	select S5PV210_PM if PM
	help
	  Enable S5PV210 CPU support

choice
	prompt "Select machine type"
	depends on ARCH_S5PV210
	default MACH_SMDKV210

config MACH_SMDKV210
	bool "SMDKV210"
	select CPU_S5PV210
	select ARCH_SPARSEMEM_ENABLE
	select S3C_DEV_HSMMC
	select S3C_DEV_HSMMC1 if !S5PV210_SD_CH0_8BIT
	select S3C_DEV_HSMMC2
	select S3C_DEV_HSMMC3 if !S5PV210_SD_CH2_8BIT
	select S5PV210_SETUP_SDHCI
	select PCI
	help
	  Machine support for Samsung SMDKV210

config MACH_SMDKC110
	bool "SMDKC110"
	select CPU_S5PV210
	select DISCONTIGMEM
	select S3C_DEV_HSMMC
	select S3C_DEV_HSMMC1 if !S5PV210_SD_CH0_8BIT
	select S3C_DEV_HSMMC2
	select S3C_DEV_HSMMC3 if !S5PV210_SD_CH2_8BIT
	select S5PV210_SETUP_SDHCI
	select ARCH_DISCONTIGMEM_ENABLE
	select PCI
	help
	  Machine support for Samsung SMDKC110
	  S5PC110(MCP) is one of package option of S5PV210

endchoice

choice
	prompt "CPU revision"
	depends on CPU_S5PV210
	default CPU_S5PV210_EVT1

config CPU_S5PV210_EVT0
	bool "EVT0"
	help
	  Support EVT0

config CPU_S5PV210_EVT1
	bool "EVT1"
	help
	  Support EVT1
endchoice

config DM9000_16BIT
	bool "DM9000 16-bit"
	depends on MACH_SMDKV210 || MACH_VOGUEV210
	default n
	help
	  Support DM9000 ethernet controller with 16bit data bus

config S5PV210_PM
	bool
	help
	  Power Management code common to S5PV210

config S5PV210_SETUP_FB_S3C
	bool
	default y
	help
	  Setup code for S5PV210 FIMD

config S5PV210_SETUP_FIMC0
	bool
	default y
	help
	  Common setup code for FIMC controller 0.

config S5PV210_SETUP_FIMC1
	bool
	default y
	help
	  Common setup code for FIMC controller 1.

config S5PV210_SETUP_FIMC2
	bool
	default y
	help
	  Common setup code for FIMC controller 2.

config S5PV210_SETUP_CSIS
	bool
	default y
	help
	  Common setup code for MIPI-CSIS


config S5PV210_SETUP_SDHCI
	bool
	depends on PLAT_S5P
	default y
	help
	  Internal helper functions for S5PCV210 based SDHCI systems

comment "MMC/SD slot setup"
depends on PLAT_S5P

menu "Use 8-bit bus width"
config S5PV210_SD_CH0_8BIT
bool "Channel 0"
depends on PLAT_S5P
default n
help
IF channel 0 uses 8-bit bus, channel 1 is disabled.

config S5PV210_SD_CH2_8BIT
bool "Channel 2"
depends on PLAT_S5P
default n
help
IF channel 2 uses 8-bit bus, channel 3 is disabled.
endmenu

# platform specific device setup
config S5PV210_ADCTS
	bool "S5PV210 ADCTS Driver"
	default y
	help
	  Common setup code for adc and touchscreen

endif
```

## arch/arm/plat-s5p/Kconfig
```kconfig
# arch/arm/plat-s5p/Kconfig
#
# Copyright (c) 2009 Samsung Electronics Co., Ltd.
#		http://www.samsung.com/
#
# Licensed under GPLv2

config PLAT_S5P
	bool
	depends on (ARCH_S5P6440 || ARCH_S5P6450 || ARCH_S5P6442 || ARCH_S5PV210)
	default y
	select ARM_VIC
	select NO_IOPORT
	select ARCH_REQUIRE_GPIOLIB
	select S3C_GPIO_TRACK
	select SAMSUNG_GPIOLIB_4BIT
	select S3C_GPIO_CFG_S3C64XX
	select S3C_GPIO_PULL_UPDOWN
	select S3C_GPIO_CFG_S3C24XX
	select PLAT_SAMSUNG
	select SAMSUNG_CLKSRC
	select SAMSUNG_IRQ_VIC_TIMER
	select SAMSUNG_IRQ_UART
	help
	  Base platform code for Samsung's S5P series SoC.

config SYSTIMER_S5P
	bool
	depends on (ARCH_S5P6442 || ARCH_S5PV210)
	default y
	help
	  Support System Timer for S5P Series

config S5P_HIGH_RES_TIMERS
        bool "HRtimer and Dynamic Tick support"
	depends on (ARCH_S5P6440 || ARCH_S5P6450 || ARCH_S5P6442 || ARCH_S5PV210)
        select GENERIC_TIME
        select GENERIC_CLOCKEVENTS
        select HIGH_RES_TIMERS
        default n
        help
          Support for HRtimer and Dynamic Tick system.

choice
        prompt "Select HRT source timer"
        depends on S5P_HIGH_RES_TIMERS
        default HRT_RTC

config HRT_PWM
        bool "PWM timers(2/4)"
        help
          PWM timers are used as HRT

config HRT_RTC
        bool "RTC/SYSTEM TIMER"
	depends on (!ARCH_S5P6450)
                help
                          RTC and System timer are used as HRT
endchoice

config S5P_DMA_PL330
	bool
	depends on (ARCH_S5PV210 || ARCH_S5P6440 || ARCH_S5P6450)
	default y
	help
	  Support DMA PL330 for all SAMSUNG S5P SOCs.


config S5P64XX_DEV_POST
        bool
	depends on (ARCH_S5PV210 || ARCH_S5P6440 || ARCH_S5P6450)
        default y
        help
          Compile in platform device definitions for post

config S5P64XX_SETUP_POST
        bool
	depends on (ARCH_S5PV210 || ARCH_S5P6440 || ARCH_S5P6450)
        default y
        help
          Common setup code for post controller.




# MFC part
config S5P_DEV_MFC
	bool
	depends on (ARCH_S5PV210 || ARCH_S5P6440 || ARCH_S5P6450)
	default y
	help
	  Compile in platform device definitions for MFC

config S5P_SETUP_MFC
	bool
	depends on (ARCH_S5PV210 || ARCH_S5P6440 || ARCH_S5P6450)
	default y
	help
	  Common setup code for MFC
```

## arch/arm/plat-tomtom/Kconfig
```kconfig
menu "TomTom Platform options"

config PLAT_MENDOZA
	bool
	help
	  Internal helper for Mendoza carrier board, directly selected
	  by the usual suspects.

config PLAT_IRVINE
	bool
	help
	  Macros and functions that are specific to the Irvine platform.

config PLAT_OFFENBURG
	bool
	help
	  Macros and functions for the Offenburg (Overo, Strasbourg, ...) platform. 

config TOMTOM_DEBUG_MODE
	bool
	default	n
	select KGDB
	select KGDB_SERIAL_CONSOLE
	help
	  Activate debug features like KGDB, and deactivate signature checks.

config TOMTOM_HAVE_SERIAL_BARRACUDA
	bool

config TOMTOM_HAVE_SPI_BARRACUDA
	bool

config TOMTOM_HAVE_SERIAL_AR15XX
	bool

config PLAT_TOMTOM
	bool "Enable TomTom platforms specific features"
	default n
	help
	  Enable the TomTom platform generic features. If unsure what to say here, 
	  "No" is a very good choice.

config TOMTOM_FDT
	bool "Enable fdt (flattened device-tree) use (library, export driver)"
	depends on PLAT_TOMTOM
	default y
	help
	  Select this option for selecting fdt device-tree parsing
	  from u-boot. Need u-boot support for it.

config TOMTOM_TT_CRYPTO
	bool "Enable ttcrypto device node"
	depends on TOMTOM_FDT
	select CRYPTO_AES
	select CRYPTO_ECB
	select CRYPTO_CBC
	default y
	help
	  Select this option to enable access to the encryption engine based on 
	  the shared secret derived by the bootloader from the boxkey and serial number 

config TOMTOM_TT_SETUP
	bool "Enable the TomTom setup handler"
	depends on PLAT_TOMTOM
	default y
	help
	  Select this option to enable the TomTom specific tt_setup methods.
          If CONFIG_TOMTOM_FDT is not available, add ALL tt_setup-registered
	  platform-devices by default.

config STRICT_DEVMEM
        bool "Filter access to /dev/mem"
	default y

config SIGN_ZIMAGE
	bool "Sign the created zImage using the TomTom DSA key"
	depends on PLAT_TOMTOM
	default y

config EARLY_PRINTK
	bool "Activate early printk"
#	depends on PLAT_TOMTOM
	default n

config TOMTOM_DEBUG
	bool "Miscellaneous debug features"
	select EARLY_PRINTK
	select DEBUG_LL
	select DEBUG_INFO
	select KALLSYMS_ALL
	select LOCALVERSION_AUTO
	depends on PLAT_TOMTOM
	default	n

config TOMTOM_VERSION
	string "TomTom version number"
	default ""
source "drivers/tomtom/Kconfig"
endmenu
```

## drivers/media/video/samsung/g2d/Kconfig
```kconfig
#
# Configuration for FIMG-2D
#

config VIDEO_G2D
	bool "Samsung FIMG-2D Driver" 
	depends on VIDEO_SAMSUNG && (CPU_S5PC110||ARCH_S5P6450)
	default n
	---help---
	  This is a FIMG-2D(2D accelerator) driver for Samsung S5PC110.
```

## drivers/media/video/samsung/post/Kconfig
```kconfig
#
# Configuration for Post Porcessor
#

config VIDEO_POST
	bool "Samsung Post Processor Driver" 
	depends on VIDEO_SAMSUNG && (ARCH_S3C64XX || ARCH_S5P6440)
	default n
	---help---
	  This is a post processor driver for Samsung S3C6410 and S5P6440.
```
