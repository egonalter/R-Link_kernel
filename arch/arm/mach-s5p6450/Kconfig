## drivers/tomtom/sensors/kxr94/Kconfig
```kconfig
# drivers/tomtom/sensors/kxr94/Kconfig
#
# Copyright (C) 2011 TomTom BV <http://www.tomtom.com/>
# Author: Matthias Kaehlcke <matthias.kaehlcke@tomtom.com>
#
# This program is free software; you can redistribute it and/or modify
# it under the terms of the GNU General Public License version 2 as
# published by the Free Software Foundation.

config TOMTOM_KXR94
	tristate "Kionix KXR94 Three-axis accelerometer driver"
	default n
	depends on TOMTOM_DRIVERS
	help
          This option enables support for the Kionix KXR94 Three-axis accelerometer.
```

## drivers/tomtom/sensors/l3gd20/Kconfig
```kconfig
# drivers/tomtom/sensors/l3gd20/Kconfig
#
# Copyright (C) 2013 TomTom BV <http://www.tomtom.com/>
#
# This program is free software; you can redistribute it and/or modify
# it under the terms of the GNU General Public License version 2 as
# published by the Free Software Foundation.

config TOMTOM_L3GD20
	tristate "STMicroelectronics L3GD20 three-axis digital gyroscope driver"
	default n
	depends on TOMTOM_DRIVERS
	help
          This option enables support for the STMicroelectronics L3GD20 three-axis Gyroscope.
```

## drivers/tomtom/sensors/lis3dh/Kconfig
```kconfig
# drivers/tomtom/sensors/lis3dh/Kconfig
#
# Copyright (C) 2011 TomTom BV <http://www.tomtom.com/>
#
# This program is free software; you can redistribute it and/or modify
# it under the terms of the GNU General Public License version 2 as
# published by the Free Software Foundation.

config TOMTOM_LIS3DH
	tristate "STMicroelectronics LIS3DH Three-axis accelerometer driver"
	default n
	depends on TOMTOM_DRIVERS
	help
          This option enables support for the STMicroelectronics LIS3DH Three-axis accelerometer.
```

## drivers/tomtom/sensors/lm26/Kconfig
```kconfig
# Copyright (C) 2013 TomTom BV <http://www.tomtom.com/>
#
# This program is free software; you can redistribute it and/or modify
# it under the terms of the GNU General Public License version 2 as
# published by the Free Software Foundation.

config TOMTOM_LM26
	tristate "LM26 Temperature sensor driver"
	default n
	depends on TOMTOM_DRIVERS && TWL4030_MADC
	help
          This option enables support for the TI temperature sensor.
```

## drivers/tomtom/sensors/ms5607/Kconfig
```kconfig
# drivers/tomtom/sensors/ms5607/Kconfig
#
# Copyright (C) 2011 TomTom BV <http://www.tomtom.com/>
# Author: Matthias Kaehlcke <matthias.kaehlcke@tomtom.com>
#
# This program is free software; you can redistribute it and/or modify
# it under the terms of the GNU General Public License version 2 as
# published by the Free Software Foundation.

config TOMTOM_MS5607
	tristate "MS5607 Pressure and Temperature sensor driver"
	default n
	depends on TOMTOM_DRIVERS
	help
          This option enables support for the MEAS MS5607 pressure and temperature sensor.
```

## drivers/tomtom/sound/Kconfig
```kconfig
# drivers/tomtom/sound/Kconfig
#
# Copyright (C) 2009 TomTom BV <http://www.tomtom.com/>
# Author: Niels Langendorff <niels.langendorff@tomtom.com>
#
# This program is free software; you can redistribute it and/or modify
# it under the terms of the GNU General Public License version 2 as
# published by the Free Software Foundation.

menuconfig TOMTOM_NASHVILLE
	default n
	depends on TOMTOM_DRIVERS
	tristate "TomTom Nashville drivers"
	---help---
          This option enables support for Nashville.


if TOMTOM_NASHVILLE

config TOMTOM_NASHVILLE_SCENARI
	tristate "Nashville scenari system"
	depends on TOMTOM_DRIVERS && (PLAT_BCM476X || MACH_CORDOBA || MACH_TORINOS || MACH_SEOUL || MACH_LIMA || MACH_HAVANA || MACH_VENICE || MACH_SANTIAGO || MACH_MONOPOLI || MACH_STRASBOURG || MACH_STRASBOURG_A2 || MACH_S5P6450_TOMTOM || MACH_STRASBOURG_XENIA)
	default y
	help
	  Enable the nashville scenari subsystem

config TOMTOM_NASHVILLE_SCENARI_DUMMY
	bool "Dummy handler"
 	depends on TOMTOM_NASHVILLE_SCENARI
	help
	  The default choice if you don't have a platform specific handler yet.

config TOMTOM_NASHVILLE_SCENARI_WM8990
	bool "WM8990 handler"
 	depends on TOMTOM_NASHVILLE_SCENARI
	depends on SND_SOC_WM8990
	help
	  Handler for the WM8990 codec.

config TOMTOM_NASHVILLE_SCENARI_ADAU1761
	bool "ADAU1761 handler"
 	depends on TOMTOM_NASHVILLE_SCENARI
	depends on SND_SOC_ADAU1761
	help
	  Handler for the Analog devices 1761 codec.

config TOMTOM_NASHVILLE_SCENARI_BCM4760
	bool "Broadcom Bcm4760 handler"
 	depends on TOMTOM_NASHVILLE_SCENARI
	depends on SND_BCM476X_SOC_INTERNAL
	help
	  Handler for the Broadcom 4760 codec.

config TOMTOM_NASHVILLE_SCENARI_S5M8751
	bool "S5M8751 handler"
 	depends on TOMTOM_NASHVILLE_SCENARI
	depends on SND_SOC_S5M8751
	default y if SND_SOC_S5M8751=y
	default y if SND_SOC_S5M8751=m
	help
	  Handler for the Samsung S5M8751 codec.

config TOMTOM_NASHVILLE_SCENARI_TLV320ADC3101
	bool "TLV320ADC3101 handler"
 	depends on TOMTOM_NASHVILLE_SCENARI
	depends on SND_SOC_TLV320ADC3101
	default y if SND_SOC_TLV320ADC3101=y
	default y if SND_SOC_TLV320ADC3101=m
	help
	  Handler for the Texas Instruments TLV320ADC3101 codec.

config TOMTOM_NASHVILLE_SCENARI_TWL4030
	bool "TI TWL4030 handler"
	depends on TOMTOM_NASHVILLE_SCENARI
	depends on SND_SOC_TWL4030
	help
	  Handler for the TI codec in the TWL4030 PMIC family

config TOMTOM_NASHVILLE_SCENARI_UDA1334
	bool "NXP UDA1334 handler"
	depends on TOMTOM_NASHVILLE_SCENARI
	depends on SND_SOC_UDA1334
	help
	  Handler for the NXP codec in the UDA1334 PMIC family

endif # TOMTOM_NASHVILLE
```

## drivers/video/omap2/displays/Kconfig
```kconfig
menu "OMAP2/3 Display Device Drivers"
        depends on OMAP2_DSS

config PANEL_GENERIC
        tristate "Generic Panel"
        help
	  Generic panel driver.
	  Used for DVI output for Beagle and OMAP3 SDP.

config PANEL_SAMSUNG_LTE430WQ_F0C
        tristate "Samsung LTE430WQ-F0C LCD Panel"
        depends on OMAP2_DSS
        help
          LCD Panel used on Overo Palo43

config PANEL_SHARP_LS037V7DW01
        tristate "Sharp LS037V7DW01 LCD Panel"
        depends on OMAP2_DSS
        help
          LCD Panel used in TI's SDP3430 and EVM boards

config PANEL_PICO_DLP
	tristate "OMAP PICO DLP Panel"
	depends on OMAP2_DSS
	help
	LCD Panel used in TI's SDP4430 and EVM boards

config PANEL_TAAL
        tristate "Taal DSI Panel"
        depends on OMAP2_DSS_DSI
        help
          Taal DSI command mode panel from TPO.

config PANEL_SHOLES
        tristate "Sholes Panel"
        help
	  LCD Panel used in sholes

config LCD_4430SDP
        tristate "OMAP4 LCD Panel"
        help
          LCD Panel used in OMAP4

config PANEL_NEC
	tristate "NEC Panel"
	help
		LCD Panel used in the Zoom board

config PANEL_SIL9022
	tristate "HDMI interface"
	help
		HDMI interface used in the Zoom board

config PANEL_SAMSUNG_LMS700KF19
	tristate "Samsung LMS700KF19 Panel"
	depends on OMAP2_DSS
	help 
		Samsung LMS700KF19 Panel

config PANEL_SAMSUNG_LMS500HF04
	tristate "Samsung LMS500HF04 Panel"
	depends on OMAP2_DSS
	help 
		Samsung LMS500HF04 Panel

config PANEL_SAMSUNG_LMS501KF03
	tristate "Samsung LMS501KF03 Panel"
	depends on OMAP2_DSS
	help 
		Samsung LMS501KF03 Panel


config PANEL_CMO_G070Y2L01
	tristate "Chi Mei Optoelectronics G070Y2-L01 Panel"
	depends on OMAP2_DSS
	help 
		Chi Mei Optoelectronics G070Y2-L01 Panel

config PANEL_LG_LD050WV1SP01
	tristate "LG LD050WV1-SP01 Panel"
	depends on (OMAP2_DSS && SPI_MASTER)
	help 
		LG LD050WV1-SP01 Panel

endmenu
```
